    ;; EEPROM default data.
    ;; Generated by Jacques Gagnon <darthcloud@gmail.com>.
    ;; See notes/gen_asm_eeprom_default.py

    db 0x00, 0x01, 0x02, 0x03, 0x04, 0x05, 0x06, 0x07, 0x08, 0x09, 0x0A, 0x0B, 0x1E, 0x13, 0x1E, 0x0F, 0x1E, 0x1E, 0x1E, 0x0A, 0x1E, 0x1E, 0x16, 0x17, 0x0B, 0x09, 0x1E, 0x1E, 0x1C, 0x1E, 0x00, 0x00
    db 0x00, 0x01, 0x02, 0x03, 0x08, 0x09, 0x0A, 0x0B, 0x04, 0x05, 0x06, 0x07, 0x1E, 0x0F, 0x1E, 0x13, 0x1E, 0x1E, 0x1E, 0x0D, 0x1E, 0x1E, 0x16, 0x17, 0x03, 0x00, 0x1E, 0x1E, 0x1C, 0x1E, 0x00, 0x00
    db 0x00, 0x01, 0x02, 0x03, 0x04, 0x05, 0x06, 0x07, 0x08, 0x09, 0x0A, 0x0B, 0x1E, 0x0F, 0x1E, 0x13, 0x1E, 0x1E, 0x1E, 0x0D, 0x1E, 0x1E, 0x16, 0x17, 0x0B, 0x09, 0x1E, 0x1E, 0x1C, 0x1E, 0x00, 0x00
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    db 0x00, 0x01, 0x02, 0x03, 0x04, 0x05, 0x06, 0x07, 0x08, 0x09, 0x0A, 0x0B, 0x1E, 0x13, 0x1E, 0x0F, 0x1E, 0x1E, 0x1E, 0x0D, 0x1E, 0x1E, 0x36, 0x37, 0x0A, 0x08, 0x1E, 0x1E, 0x1C, 0x1E, 0x00, 0x00

