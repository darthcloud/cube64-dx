    ;; Large 256 byte table for CRC calculation.
    ;; Generated by Jacques Gagnon <darthcloud@gmail.com>.
    ;; See notes/gen_asm_large_table_crc.py

    db  0x85, 0x8F, 0x9B, 0xB3, 0xE3, 0x43, 0x86, 0x89, 0x97, 0xAB, 0xD3, 0x23, 0x46, 0x8C, 0x9D, 0xBF, 0xFB, 0x73, 0xE6, 0x49, 0x92, 0xA1, 0xC7, 0x0B, 0x16, 0x2C, 0x58, 0xB0, 0xE5, 0x4F, 0x9E, 0xB9, 0xF7, 0x6B, 0xD6, 0x29, 0x52, 0xA4, 0xCD, 0x1F, 0x3E, 0x7C, 0xF8, 0x75, 0xEA, 0x51, 0xA2, 0xC1, 0x07, 0x0E, 0x1C, 0x38, 0x70, 0xE0, 0x45, 0x8A, 0x91, 0xA7, 0xCB, 0x13, 0x26, 0x4C, 0x98, 0xB5, 0xEF, 0x5B, 0xB6, 0xE9, 0x57, 0xAE, 0xD9, 0x37, 0x6E, 0xDC, 0x3D, 0x7A, 0xF4, 0x6D, 0xDA, 0x31, 0x62, 0xC4, 0x0D, 0x1A, 0x34, 0x68, 0xD0, 0x25, 0x4A, 0x94, 0xAD, 0xDF, 0x3B, 0x76, 0xEC, 0x5D, 0xBA, 0xF1, 0x67, 0xCE, 0x19, 0x32, 0x64, 0xC8, 0x15, 0x2A, 0x54, 0xA8, 0xD5, 0x2F, 0x5E, 0xBC, 0xFD, 0x7F, 0xFE, 0x79, 0xF2, 0x61, 0xC2, 0x01, 0x02, 0x04, 0x08, 0x10, 0x20, 0x40, 0x80, 0x85, 0x8F, 0x9B, 0xB3, 0xE3, 0x43, 0x86, 0x89, 0x97, 0xAB, 0xD3, 0x23, 0x46, 0x8C, 0x9D, 0xBF, 0xFB, 0x73, 0xE6, 0x49, 0x92, 0xA1, 0xC7, 0x0B, 0x16, 0x2C, 0x58, 0xB0, 0xE5, 0x4F, 0x9E, 0xB9, 0xF7, 0x6B, 0xD6, 0x29, 0x52, 0xA4, 0xCD, 0x1F, 0x3E, 0x7C, 0xF8, 0x75, 0xEA, 0x51, 0xA2, 0xC1, 0x07, 0x0E, 0x1C, 0x38, 0x70, 0xE0, 0x45, 0x8A, 0x91, 0xA7, 0xCB, 0x13, 0x26, 0x4C, 0x98, 0xB5, 0xEF, 0x5B, 0xB6, 0xE9, 0x57, 0xAE, 0xD9, 0x37, 0x6E, 0xDC, 0x3D, 0x7A, 0xF4, 0x6D, 0xDA, 0x31, 0x62, 0xC4, 0x0D, 0x1A, 0x34, 0x68, 0xD0, 0x25, 0x4A, 0x94, 0xAD, 0xDF, 0x3B, 0x76, 0xEC, 0x5D, 0xBA, 0xF1, 0x67, 0xCE, 0x19, 0x32, 0x64, 0xC8, 0x15, 0x2A, 0x54, 0xA8, 0xD5, 0x2F, 0x5E, 0xBC, 0xFD, 0x7F, 0xFE, 0x79, 0xF2, 0x61, 0xC2, 0x01, 0x02, 0x04, 0x08, 0x10, 0x20, 0x40, 0x80, 0x85, 0x8F
