    ;; Large 256 byte table for CRC calculation.
    ;; Generated by Jacques Gagnon using modified crc.py script from Micah Dowty.
    ;; See notes/crc_largetable_gen_asm.py .

    retlw   0x8F    ; 0x00
    retlw   0x85    ; 0x01
    retlw   0x80    ; 0x02
    retlw   0x40    ; 0x03
    retlw   0x20    ; 0x04
    retlw   0x10    ; 0x05
    retlw   0x08    ; 0x06
    retlw   0x04    ; 0x07
    retlw   0x02    ; 0x08
    retlw   0x01    ; 0x09
    retlw   0xC2    ; 0x0A
    retlw   0x61    ; 0x0B
    retlw   0xF2    ; 0x0C
    retlw   0x79    ; 0x0D
    retlw   0xFE    ; 0x0E
    retlw   0x7F    ; 0x0F
    retlw   0xFD    ; 0x10
    retlw   0xBC    ; 0x11
    retlw   0x5E    ; 0x12
    retlw   0x2F    ; 0x13
    retlw   0xD5    ; 0x14
    retlw   0xA8    ; 0x15
    retlw   0x54    ; 0x16
    retlw   0x2A    ; 0x17
    retlw   0x15    ; 0x18
    retlw   0xC8    ; 0x19
    retlw   0x64    ; 0x1A
    retlw   0x32    ; 0x1B
    retlw   0x19    ; 0x1C
    retlw   0xCE    ; 0x1D
    retlw   0x67    ; 0x1E
    retlw   0xF1    ; 0x1F
    retlw   0xBA    ; 0x20
    retlw   0x5D    ; 0x21
    retlw   0xEC    ; 0x22
    retlw   0x76    ; 0x23
    retlw   0x3B    ; 0x24
    retlw   0xDF    ; 0x25
    retlw   0xAD    ; 0x26
    retlw   0x94    ; 0x27
    retlw   0x4A    ; 0x28
    retlw   0x25    ; 0x29
    retlw   0xD0    ; 0x2A
    retlw   0x68    ; 0x2B
    retlw   0x34    ; 0x2C
    retlw   0x1A    ; 0x2D
    retlw   0x0D    ; 0x2E
    retlw   0xC4    ; 0x2F
    retlw   0x62    ; 0x30
    retlw   0x31    ; 0x31
    retlw   0xDA    ; 0x32
    retlw   0x6D    ; 0x33
    retlw   0xF4    ; 0x34
    retlw   0x7A    ; 0x35
    retlw   0x3D    ; 0x36
    retlw   0xDC    ; 0x37
    retlw   0x6E    ; 0x38
    retlw   0x37    ; 0x39
    retlw   0xD9    ; 0x3A
    retlw   0xAE    ; 0x3B
    retlw   0x57    ; 0x3C
    retlw   0xE9    ; 0x3D
    retlw   0xB6    ; 0x3E
    retlw   0x5B    ; 0x3F
    retlw   0xEF    ; 0x40
    retlw   0xB5    ; 0x41
    retlw   0x98    ; 0x42
    retlw   0x4C    ; 0x43
    retlw   0x26    ; 0x44
    retlw   0x13    ; 0x45
    retlw   0xCB    ; 0x46
    retlw   0xA7    ; 0x47
    retlw   0x91    ; 0x48
    retlw   0x8A    ; 0x49
    retlw   0x45    ; 0x4A
    retlw   0xE0    ; 0x4B
    retlw   0x70    ; 0x4C
    retlw   0x38    ; 0x4D
    retlw   0x1C    ; 0x4E
    retlw   0x0E    ; 0x4F
    retlw   0x07    ; 0x50
    retlw   0xC1    ; 0x51
    retlw   0xA2    ; 0x52
    retlw   0x51    ; 0x53
    retlw   0xEA    ; 0x54
    retlw   0x75    ; 0x55
    retlw   0xF8    ; 0x56
    retlw   0x7C    ; 0x57
    retlw   0x3E    ; 0x58
    retlw   0x1F    ; 0x59
    retlw   0xCD    ; 0x5A
    retlw   0xA4    ; 0x5B
    retlw   0x52    ; 0x5C
    retlw   0x29    ; 0x5D
    retlw   0xD6    ; 0x5E
    retlw   0x6B    ; 0x5F
    retlw   0xF7    ; 0x60
    retlw   0xB9    ; 0x61
    retlw   0x9E    ; 0x62
    retlw   0x4F    ; 0x63
    retlw   0xE5    ; 0x64
    retlw   0xB0    ; 0x65
    retlw   0x58    ; 0x66
    retlw   0x2C    ; 0x67
    retlw   0x16    ; 0x68
    retlw   0x0B    ; 0x69
    retlw   0xC7    ; 0x6A
    retlw   0xA1    ; 0x6B
    retlw   0x92    ; 0x6C
    retlw   0x49    ; 0x6D
    retlw   0xE6    ; 0x6E
    retlw   0x73    ; 0x6F
    retlw   0xFB    ; 0x70
    retlw   0xBF    ; 0x71
    retlw   0x9D    ; 0x72
    retlw   0x8C    ; 0x73
    retlw   0x46    ; 0x74
    retlw   0x23    ; 0x75
    retlw   0xD3    ; 0x76
    retlw   0xAB    ; 0x77
    retlw   0x97    ; 0x78
    retlw   0x89    ; 0x79
    retlw   0x86    ; 0x7A
    retlw   0x43    ; 0x7B
    retlw   0xE3    ; 0x7C
    retlw   0xB3    ; 0x7D
    retlw   0x9B    ; 0x7E
    retlw   0x8F    ; 0x7F
    retlw   0x85    ; 0x80
    retlw   0x80    ; 0x81
    retlw   0x40    ; 0x82
    retlw   0x20    ; 0x83
    retlw   0x10    ; 0x84
    retlw   0x08    ; 0x85
    retlw   0x04    ; 0x86
    retlw   0x02    ; 0x87
    retlw   0x01    ; 0x88
    retlw   0xC2    ; 0x89
    retlw   0x61    ; 0x8A
    retlw   0xF2    ; 0x8B
    retlw   0x79    ; 0x8C
    retlw   0xFE    ; 0x8D
    retlw   0x7F    ; 0x8E
    retlw   0xFD    ; 0x8F
    retlw   0xBC    ; 0x90
    retlw   0x5E    ; 0x91
    retlw   0x2F    ; 0x92
    retlw   0xD5    ; 0x93
    retlw   0xA8    ; 0x94
    retlw   0x54    ; 0x95
    retlw   0x2A    ; 0x96
    retlw   0x15    ; 0x97
    retlw   0xC8    ; 0x98
    retlw   0x64    ; 0x99
    retlw   0x32    ; 0x9A
    retlw   0x19    ; 0x9B
    retlw   0xCE    ; 0x9C
    retlw   0x67    ; 0x9D
    retlw   0xF1    ; 0x9E
    retlw   0xBA    ; 0x9F
    retlw   0x5D    ; 0xA0
    retlw   0xEC    ; 0xA1
    retlw   0x76    ; 0xA2
    retlw   0x3B    ; 0xA3
    retlw   0xDF    ; 0xA4
    retlw   0xAD    ; 0xA5
    retlw   0x94    ; 0xA6
    retlw   0x4A    ; 0xA7
    retlw   0x25    ; 0xA8
    retlw   0xD0    ; 0xA9
    retlw   0x68    ; 0xAA
    retlw   0x34    ; 0xAB
    retlw   0x1A    ; 0xAC
    retlw   0x0D    ; 0xAD
    retlw   0xC4    ; 0xAE
    retlw   0x62    ; 0xAF
    retlw   0x31    ; 0xB0
    retlw   0xDA    ; 0xB1
    retlw   0x6D    ; 0xB2
    retlw   0xF4    ; 0xB3
    retlw   0x7A    ; 0xB4
    retlw   0x3D    ; 0xB5
    retlw   0xDC    ; 0xB6
    retlw   0x6E    ; 0xB7
    retlw   0x37    ; 0xB8
    retlw   0xD9    ; 0xB9
    retlw   0xAE    ; 0xBA
    retlw   0x57    ; 0xBB
    retlw   0xE9    ; 0xBC
    retlw   0xB6    ; 0xBD
    retlw   0x5B    ; 0xBE
    retlw   0xEF    ; 0xBF
    retlw   0xB5    ; 0xC0
    retlw   0x98    ; 0xC1
    retlw   0x4C    ; 0xC2
    retlw   0x26    ; 0xC3
    retlw   0x13    ; 0xC4
    retlw   0xCB    ; 0xC5
    retlw   0xA7    ; 0xC6
    retlw   0x91    ; 0xC7
    retlw   0x8A    ; 0xC8
    retlw   0x45    ; 0xC9
    retlw   0xE0    ; 0xCA
    retlw   0x70    ; 0xCB
    retlw   0x38    ; 0xCC
    retlw   0x1C    ; 0xCD
    retlw   0x0E    ; 0xCE
    retlw   0x07    ; 0xCF
    retlw   0xC1    ; 0xD0
    retlw   0xA2    ; 0xD1
    retlw   0x51    ; 0xD2
    retlw   0xEA    ; 0xD3
    retlw   0x75    ; 0xD4
    retlw   0xF8    ; 0xD5
    retlw   0x7C    ; 0xD6
    retlw   0x3E    ; 0xD7
    retlw   0x1F    ; 0xD8
    retlw   0xCD    ; 0xD9
    retlw   0xA4    ; 0xDA
    retlw   0x52    ; 0xDB
    retlw   0x29    ; 0xDC
    retlw   0xD6    ; 0xDD
    retlw   0x6B    ; 0xDE
    retlw   0xF7    ; 0xDF
    retlw   0xB9    ; 0xE0
    retlw   0x9E    ; 0xE1
    retlw   0x4F    ; 0xE2
    retlw   0xE5    ; 0xE3
    retlw   0xB0    ; 0xE4
    retlw   0x58    ; 0xE5
    retlw   0x2C    ; 0xE6
    retlw   0x16    ; 0xE7
    retlw   0x0B    ; 0xE8
    retlw   0xC7    ; 0xE9
    retlw   0xA1    ; 0xEA
    retlw   0x92    ; 0xEB
    retlw   0x49    ; 0xEC
    retlw   0xE6    ; 0xED
    retlw   0x73    ; 0xEE
    retlw   0xFB    ; 0xEF
    retlw   0xBF    ; 0xF0
    retlw   0x9D    ; 0xF1
    retlw   0x8C    ; 0xF2
    retlw   0x46    ; 0xF3
    retlw   0x23    ; 0xF4
    retlw   0xD3    ; 0xF5
    retlw   0xAB    ; 0xF6
    retlw   0x97    ; 0xF7
    retlw   0x89    ; 0xF8
    retlw   0x86    ; 0xF9
    retlw   0x43    ; 0xFA
    retlw   0xE3    ; 0xFB
    retlw   0xB3    ; 0xFC
    retlw   0x9B    ; 0xFD
    retlw   0x8F    ; 0xFE
    retlw   0x85    ; 0xFF
